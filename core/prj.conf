## CMakeLists.txt
```
cmake_minimum_required(VERSION 3.20.0)

find_package(Zephyr REQUIRED HINTS $ENV{ZEPHYR_BASE})
project(core)

# target_compile_options(app PRIVATE -DREPORT_THMALLOC_STATS=1)
# target_compile_options(app PRIVATE -DHOST_EXAMPLE_CODE=1)
# target_compile_options(app PRIVATE -DCORE_DEBUG=1)
# target_compile_options(app PRIVATE -DTHDEBUG=3)
# target_compile_options(app PRIVATE -DBMDEBUG=1)


target_compile_options(app PRIVATE -DNO_ALIGNED_ALLOC=1)
target_compile_options(app PRIVATE -DHAVE_SYS_STAT_H=1)

if(CONFIG_64BIT)
target_compile_options(app PRIVATE -DEE_SIZEOF_LONG=8)
target_compile_options(app PRIVATE -DEE_SIZEOF_PTR=8)
target_compile_options(app PRIVATE -DEE_PTR_ALIGN=8)
endif()

target_compile_options(app PRIVATE -DW_WORKERS_NUM=1)

OPTION(CONTEXT_NUM "Number of contexts" 2)
target_compile_options(app PRIVATE -DC_CONTEXT_NUM=${CONTEXT_NUM})

OPTION(ITERATION_NUM "Number of iterations" 1)
target_compile_options(app PRIVATE -DI_ITERATION_NUM=${ITERATION_NUM})


# MITH headers
include_directories(../mith/include)
include_directories(../mith/al/include)

# MITH sources
FILE(GLOB mith_sources ../mith/al/src/*.c ../mith/src/*.c)
target_sources(app PRIVATE ${mith_sources})

# core sources
FILE(GLOB app_sources src/*.c)
target_sources(app PRIVATE ${app_sources})
```

## prj.conf
```kconfig
# Use Portable threads
#CONFIG_POSIX_API=y
CONFIG_PTHREAD_IPC=y
CONFIG_POSIX_CLOCK=y
CONFIG_MAX_PTHREAD_COUNT=64
CONFIG_MAX_PTHREAD_MUTEX_COUNT=16
CONFIG_MAX_PTHREAD_COND_COUNT=16
CONFIG_MAX_PTHREAD_KEY_COUNT=16

CONFIG_NEWLIB_LIBC_MIN_REQUIRED_HEAP_SIZE=512000
CONFIG_INIT_STACKS=y

# Use stack
CONFIG_MAIN_STACK_SIZE=8192
CONFIG_ISR_STACK_SIZE=4096
CONFIG_IDLE_STACK_SIZE=4096

# Use floating point printf
CONFIG_NEWLIB_LIBC=y
CONFIG_NEWLIB_LIBC_FLOAT_PRINTF=y

# Speed is what I need
CONFIG_SPEED_OPTIMIZATIONS=y
```

## src/core.c
```c
/* Created with: ../xml/core.xml */
/* common */
#include "th_lib.h"
#include "mith_workload.h"
#include "al_smp.h"

/* helper function to initialize a workload item */
ee_work_item_t *helper_core(ee_workload *workload, void *params, char *name, void * (*init_func)(void *), e_u32 repeats_override,
			void * (*bench_func)(struct TCDef *,void *), int (*cleanup)(void *), void * (*fini_func)(void *), int (*veri_func)(void *), int ncont,
			e_u32 kernel_id, e_u32 instance_id) {
	ee_work_item_t *item;
	if (params==NULL) {
		th_exit(1,"Error when trying to define benchmark params");
	}
	item=mith_item_init(repeats_override);
	item->params=params;
	if (th_strlen(name)>(MITH_MAX_NAME-1)) {
		th_strncpy(item->shortname,name,MITH_MAX_NAME-1);
		item->shortname[MITH_MAX_NAME-1]='\0';
	}
	else
		th_strcpy(item->shortname,name);
	item->init_func=init_func;
	item->fini_func=fini_func;
	item->veri_func=veri_func;
	item->bench_func=bench_func;
	item->cleanup=cleanup;
	item->num_contexts=ncont;
	item->kernel_id=kernel_id;
	item->instance_id=instance_id;
	mith_wl_add(workload,item);
	return item;
}
/* generated function types for each work item */
/* core */
extern void *define_params_core(unsigned int idx, char *name, char *dataset);
extern void *bmark_init_core(void *);
extern void *bmark_fini_core(void *);
extern void *t_run_test_core(struct TCDef *,void *);
extern int bmark_verify_core(void *);
extern int bmark_clean_core(void *);

/* main function to create the workload, run it, and report results */
MAIN_TB
{
	char name[MITH_MAX_NAME];
	char dataname_buf[MITH_MAX_NAME];
	char *dataname;
	char *hardware_desc;
	int orig_dataname=1;
	void *retval;
	unsigned i;
	/* default values */
	e_u32 num_contexts=1;
	e_u32 num_workers=0;
	e_u32 bench_repeats=1;
	e_u32 oversubscribe_allowed=1;
	ee_work_item_t **real_items;
	ee_workload *workload;

	/* first do abstraction layer specific initalizations */
	al_main(argc,argv);

	/* now prepare workload */
	workload = mith_wl_init(1); /* num items extracted from xml: sum(item*instances) for all items */
	real_items = (ee_work_item_t **)th_malloc(sizeof(ee_work_item_t *)*1);
	th_strncpy(workload->shortname,"core",MITH_MAX_NAME);
	workload->rev_M=1;
	workload->rev_m=1;
	workload->uid=490760323;
	workload->iterations=1;

	/* parse command line for overrides
	   overrides for num_iterations, num_contexts,
	   and bench iterations for all items */
	{ e_s32 stmp;
	th_parse_flag_unsigned(argc,argv,"-i",&workload->iterations);
	th_parse_flag_unsigned(argc,argv,"-c",&num_contexts);
	th_parse_flag_unsigned(argc,argv,"-w",&num_workers);
	th_parse_flag_unsigned(argc,argv,"-b",&bench_repeats);
	th_parse_flag_unsigned(argc,argv,"-o",&oversubscribe_allowed);
	th_parse_flag_unsigned(argc,argv,"-v",&verify_output);
	th_parse_flag_unsigned(argc,argv,"-V",&reporting_threshold);
	if (th_parse_flag(argc,argv,"-pgo=",&stmp)) 
		pgo_training_run=stmp;
	}
	if (th_get_flag(argc,argv,"-D=",&dataname))
		orig_dataname=0;
	else
		dataname=dataname_buf;
	/* check command line for hardware specific information */
	if (th_get_flag(argc,argv,"-P=",&hardware_desc)) {
		al_set_hardware_info(hardware_desc);
	}

	/* SG/Test: make sure we have enough iterations to engage all contexts at least once */
	while (num_contexts > (workload->iterations * 1))
		workload->iterations++;
	
/* ITEM 0-0 [0]*/
	th_strncpy(name,"core",MITH_MAX_NAME);
	if (orig_dataname) {
		th_strncpy(dataname,"andebench",MITH_MAX_NAME);
	}
	retval=define_params_core(0,name,dataname);
	real_items[0]=helper_core(workload,retval,name,bmark_init_core,bench_repeats,t_run_test_core,bmark_clean_core,bmark_fini_core,bmark_verify_core,1,(e_u32)257963578,(e_u32)2045561353);

	/* Run the workload */
	mith_main(workload,workload->iterations,num_contexts,oversubscribe_allowed,num_workers);
	/* And cleanup */
	th_free(real_items);
	for (i=0; i<workload->max_idx ; i++) {
		ee_work_item_t *item=workload->load[i];
		item->cleanup(item->params);
	}
	mith_wl_destroy(workload);
	workload=NULL;
return 0;
}
```

## src/core_list_join.c
```c
/*
(C) 2014 EEMBC(R).  All rights reserved.                            

All EEMBC Benchmark Software are products of EEMBC 
and are provided under the terms of the EEMBC Benchmark License Agreements.  
The EEMBC Benchmark Software are proprietary intellectual properties of EEMBC and its Members 
and is protected under all applicable laws, including all applicable copyright laws.  
If you received this EEMBC Benchmark Software without having 
a currently effective EEMBC Benchmark License Agreement, you must discontinue use. 
Please refer to LICENSE.md for the specific license agreement that pertains to this Benchmark Software.
*/

/*
Author : Shay Gal-On, EEMBC
*/ 

#include "coremark.h"
/*
Topic: Description
	Benchmark using a linked list.

	Linked list is a common data structure used in many applications.
	
	For our purposes, this will excercise the memory units of the processor.
	In particular, usage of the list pointers to find and alter data.
	
	We are not using Malloc since some platforms do not support this library.
	
	Instead, the memory block being passed in is used to create a list,
	and the benchmark takes care not to add more items then can be
	accomodated by the memory block. The porting layer will make sure
	that we have a valid memory block.
	
	All operations are done in place, without using any extra memory.
	
	The list itself contains list pointers and pointers to data items.
	Data items contain the following:
	
	idx - An index that captures the initial order of the list.
	data - Variable data initialized based on the input parameters. The 16b are divided as follows:
	o Upper 8b are backup of original data.
	o Bit 7 indicates if the lower 7 bits are to be used as is or calculated.
	o Bits 0-2 indicate type of operation to perform to get a 7b value.
	o Bits 3-6 provide input for the operation.
	
*/

/* local functions */

list_head *core_list_find(list_head *list,list_data *info);
list_head *core_list_reverse(list_head *list);
list_head *core_list_remove(list_head *item);
list_head *core_list_undo_remove(list_head *item_removed, list_head *item_modified);
list_head *core_list_insert_new(list_head *insert_point
	, list_data *info, list_head **memblock, list_data **datablock
	, list_head *memblock_end, list_data *datablock_end);
typedef ee_s32(*list_cmp)(list_data *a, list_data *b, core_results *res);
list_head *core_list_mergesort(list_head *list, list_cmp cmp, core_results *res);

ee_s16 calc_func(ee_s16 *pdata, core_results *res) {
	ee_s16 data=*pdata;
	ee_s16 retval;
	ee_u8 optype=(data>>7) & 1; /* bit 7 indicates if the function result has been cached */
	if (optype) /* if cached, use cache */
		return (data & 0x007f);
	else { /* otherwise calculate and cache the result */
		ee_s16 flag=data & 0x7; /* bits 0-2 is type of function to perform */
		ee_s16 dtype=((data>>3) & 0xf); /* bits 3-6 is specific data for the operation */
		dtype |= dtype << 4; /* replicate the lower 4 bits to get an 8b value */
		switch (flag) {
			case 0:
				if (dtype<0x22) /* set min period for bit corruption */
					dtype=0x22;
				retval=core_bench_state(res->size,(ee_u8 *)res->memblock[3],res->seed1,res->seed2,dtype,res->crc);
				if (res->crcstate==0)
					res->crcstate=retval;
				break;
			case 1:
				retval=core_bench_matrix(&(res->mat),dtype,res->crc);
				if (res->crcmatrix==0)
					res->crcmatrix=retval;
				break;
			default:
				retval=data;
				break;
		}
		res->crc=crcu16(retval,res->crc);
		retval &= 0x007f; 
		*pdata = (data & 0xff00) | 0x0080 | retval; /* cache the result */
		return retval;
	}
}
/* Function: cmp_complex
	Compare the data item in a list cell.

	Can be used by mergesort.
*/
ee_s32 cmp_complex(list_data *a, list_data *b, core_results *res) {
	ee_s16 val1=calc_func(&(a->data16),res);
	ee_s16 val2=calc_func(&(b->data16),res);
	return val1 - val2;
}

/* Function: cmp_idx
	Compare the idx item in a list cell, and regen the data.

	Can be used by mergesort.
*/
ee_s32 cmp_idx(list_data *a, list_data *b, core_results *res) {
	if (res==NULL) {
		a->data16 = (a->data16 & 0xff00) | (0x00ff & (a->data16>>8));
		b->data16 = (b->data16 & 0xff00) | (0x00ff & (b->data16>>8));
	}
	return a->idx - b->idx;
}

void copy_info(list_data *to,list_data *from) {
	to->data16=from->data16;
	to->idx=from->idx;
}

/* Benchmark for linked list:
	- Try to find multiple data items.
	- List sort
	- Operate on data from list (crc)
	- Single remove/reinsert
	* At the end of this function, the list is back to original state
*/
ee_u16 core_bench_list(core_results *res, ee_s16 finder_idx) {
	ee_u16 retval=0;
	ee_u16 found=0,missed=0;
	list_head *list=res->list;
	ee_s16 find_num=res->seed3;
	list_head *this_find;
	list_head *finder, *remover;
	list_data info;
	ee_s16 i;

	info.idx=finder_idx;
	/* find <find_num> values in the list, and change the list each time (reverse and cache if value found) */
	for (i=0; i<find_num; i++) {
		info.data16= (i & 0xff) ;
		this_find=core_list_find(list,&info);
		list=core_list_reverse(list);
		if (this_find==NULL) {
			missed++;
			retval+=(list->next->info->data16 >> 8) & 1;
		}
		else {
			found++;
			if (this_find->info->data16 & 0x1) /* use found value */
				retval+=(this_find->info->data16 >> 9) & 1;
			/* and cache next item at the head of the list (if any) */
			if (this_find->next != NULL) {
				finder = this_find->next;
				this_find->next = finder->next;
				finder->next=list->next;
				list->next=finder;
			}
		}
		if (info.idx>=0)
			info.idx++;
#if CORE_DEBUG
	ee_printf("List find %d: [%d,%d,%d]\n",i,retval,missed,found);
#endif
	}
	retval+=found*4-missed;
	/* sort the list by data content and remove one item*/
	if (finder_idx>0)
		list=core_list_mergesort(list,cmp_complex,res);
	remover=core_list_remove(list->next);
	/* CRC data content of list from location of index N forward, and then undo remove */
	finder=core_list_find(list,&info);
	if (!finder)
		finder=list->next;
	while (finder) {
		retval=crc16_cm(list->info->data16,retval);
		finder=finder->next;
	}
#if CORE_DEBUG
	ee_printf("List sort 1: %04x\n",retval);
#endif
	remover=core_list_undo_remove(remover,list->next);
	/* sort the list by index, in effect returning the list to original state */
	list=core_list_mergesort(list,cmp_idx,NULL);
	/* CRC data content of list */
	finder=list->next;
	while (finder) {
		retval=crc16_cm(list->info->data16,retval);
		finder=finder->next;
	}
#if CORE_DEBUG
	ee_printf("List sort 2: %04x\n",retval);
#endif
	return retval;
}
/* Function: core_list_init
	Initialize list with data.

	Parameters:
	blksize - Size of memory to be initialized.
	memblock - Pointer to memory block.
	seed - 	Actual values chosen depend on the seed parameter.
		The seed parameter MUST be supplied from a source that cannot be determined at compile time

	Returns:
	Pointer to the head of the list.

*/
list_head *core_list_init(ee_u32 blksize, list_head *memblock, ee_s16 seed) {
	/* calculated pointers for the list */
	ee_u32 per_item=16+sizeof(struct list_data_s);
	ee_u32 size=blksize; 
	list_head *memblock_end=memblock+size;
	list_data *datablock=(list_data *)(memblock_end);
	list_data *datablock_end=datablock+size;
	/* some useful variables */
	ee_u32 i;
	list_head *finder,*list=memblock;
	list_data info;

	/* create a fake items for the list head and tail */
	list->next=NULL;
	list->info=datablock;
	list->info->idx=0x0000;
	list->info->data16=(ee_s16)0x8080;
	memblock++;
	datablock++;
	info.idx=0x7fff;
	info.data16=(ee_s16)0xffff;
	core_list_insert_new(list,&info,&memblock,&datablock,memblock_end,datablock_end);
	
	/* then insert size items */
	for (i=0; i<size; i++) {
		ee_u16 datpat=((ee_u16)(seed^i) & 0xf);
		ee_u16 dat=(datpat<<3) | (i&0x7); /* alternate between algorithms */
		info.data16=(dat<<8) | dat;		/* fill the data with actual data and upper bits with rebuild value */
		core_list_insert_new(list,&info,&memblock,&datablock,memblock_end,datablock_end);
	}
	/* and now index the list so we know initial seed order of the list */
	finder=list->next;
	i=1;
	while (finder->next!=NULL) {
		if (i<size/5) /* first 20% of the list in order */
			finder->info->idx=i++;
		else { 
			ee_u16 pat=(ee_u16)(i++ ^ seed); /* get a pseudo random number */
			finder->info->idx=0x3fff & (((i & 0x07) << 8) | pat); /* make sure the mixed items end up after the ones in sequence */
		}
		finder=finder->next;
	}
	list = core_list_mergesort(list,cmp_idx,NULL);
#if CORE_DEBUG
	ee_printf("Initialized list:\n");
	finder=list;
	while (finder) {
		ee_printf("[%04x,%04x,%x]",finder->info->idx,(ee_u16)finder->info->data16,finder);
		finder=finder->next;
	}
	ee_printf("\n");
#endif
	return list;
}

/* Function: core_list_insert
	Insert an item to the list

	Parameters:
	insert_point - where to insert the item.
	info - data for the cell.
	memblock - pointer for the list header
	datablock - pointer for the list data
	memblock_end - end of region for list headers
	datablock_end - end of region for list data

	Returns:
	Pointer to new item.
*/
list_head *core_list_insert_new(list_head *insert_point, list_data *info, list_head **memblock, list_data **datablock
	, list_head *memblock_end, list_data *datablock_end) {
	list_head *newitem;
	
	if ((*memblock+1) >= memblock_end)
		return NULL;
	if ((*datablock+1) >= datablock_end)
		return NULL;
		
	newitem=*memblock;
	(*memblock)++;
	newitem->next=insert_point->next;
	insert_point->next=newitem;
	
	newitem->info=*datablock;
	(*datablock)++;
	copy_info(newitem->info,info);
	
	return newitem;
}

/* Function: core_list_remove
	Remove an item from the list.

	Operation:
	For a singly linked list, remove by copying the data from the next item 
	over to the current cell, and unlinking the next item.

	Note: 
	since there is always a fake item at the end of the list, no need to check for NULL.

	Returns:
	Removed item.
*/
list_head *core_list_remove(list_head *item) {
	list_data *tmp;
	list_head *ret=item->next;
	/* swap data pointers */
	tmp=item->info;
	item->info=ret->info;
	ret->info=tmp;
	/* and eliminate item */
	item->next=item->next->next;
	ret->next=NULL;
	return ret;
}

/* Function: core_list_undo_remove
	Undo a remove operation.

	Operation:
	Since we want each iteration of the benchmark to be exactly the same,
	we need to be able to undo a remove. 
	Link the removed item back into the list, and switch the info items.

	Parameters:
	item_removed - Return value from the <core_list_remove>
	item_modified - List item that was modified during <core_list_remove>

	Returns:
	The item that was linked back to the list.
	
*/
list_head *core_list_undo_remove(list_head *item_removed, list_head *item_modified) {
	list_data *tmp;
	/* swap data pointers */
	tmp=item_removed->info;
	item_removed->info=item_modified->info;
	item_modified->info=tmp;
	/* and insert item */
	item_removed->next=item_modified->next;
	item_modified->next=item_removed;
	return item_removed;
}

/* Function: core_list_find
	Find an item in the list

	Operation:
	Find an item by idx (if not 0) or specific data value

	Parameters:
	list - list head
	info - idx or data to find

	Returns:
	Found item, or NULL if not found.
*/
list_head *core_list_find(list_head *head,list_data *info) {
	list_head *list=head;
	if (info->idx>=0) {
		while (list && (list->info->idx != info->idx))
			list=list->next;
		return list;
	} else {
		while (list && ((list->info->data16 & 0xff) != info->data16))
			list=list->next;
		return list;
	}
}
/* Function: core_list_reverse
	Reverse a list

	Operation:
	Rearrange the pointers so the list is reversed.

	Parameters:
	list - list head
	info - idx or data to find

	Returns:
	Found item, or NULL if not found.
*/

list_head *core_list_reverse(list_head *list) {
	list_head *next=NULL, *tmp;
	while (list) {
		tmp=list->next;
		list->next=next;
		next=list;
		list=tmp;
	}
	return next;
}
/* Function: core_list_mergesort
	Sort the list in place without recursion.

	Description:
	Use mergesort, as for linked list this is a realistic solution. 
	Also, since this is aimed at embedded, care was taken to use iterative rather then recursive algorithm.
	The sort can either return the list to original order (by idx) ,
	or use the data item to invoke other other algorithms and change the order of the list.

	Parameters:
	list - list to be sorted.
	cmp - cmp function to use

	Returns:
	New head of the list.

	Note: 
	We have a special header for the list that will always be first,
	but the algorithm could theoretically modify where the list starts.

 */
list_head *core_list_mergesort(list_head *list, list_cmp cmp, core_results *res) {
    list_head *p, *q, *e, *tail;
    ee_s32 insize, nmerges, psize, qsize, i;

    insize = 1;

    while (1) {
        p = list;
        list = NULL;
        tail = NULL;

        nmerges = 0;  /* count number of merges we do in this pass */

        while (p) {
            nmerges++;  /* there exists a merge to be done */
            /* step `insize' places along from p */
            q = p;
            psize = 0;
            for (i = 0; i < insize; i++) {
                psize++;
			    q = q->next;
                if (!q) break;
            }

            /* if q hasn't fallen off end, we have two lists to merge */
            qsize = insize;

            /* now we have two lists; merge them */
            while (psize > 0 || (qsize > 0 && q)) {

				/* decide whether next element of merge comes from p or q */
				if (psize == 0) {
				    /* p is empty; e must come from q. */
				    e = q; q = q->next; qsize--;
				} else if (qsize == 0 || !q) {
				    /* q is empty; e must come from p. */
				    e = p; p = p->next; psize--;
				} else if (cmp(p->info,q->info,res) <= 0) {
				    /* First element of p is lower (or same); e must come from p. */
				    e = p; p = p->next; psize--;
				} else {
				    /* First element of q is lower; e must come from q. */
				    e = q; q = q->next; qsize--;
				}

		        /* add the next element to the merged list */
				if (tail) {
				    tail->next = e;
				} else {
				    list = e;
				}
				tail = e;
	        }

			/* now p has stepped `insize' places along, and q has too */
			p = q;
        }
		
	    tail->next = NULL;

        /* If we have done only one merge, we're finished. */
        if (nmerges <= 1)   /* allow for nmerges==0, the empty list case */
            return list;

        /* Otherwise repeat, merging lists twice the size */
        insize *= 2;
    }
#if COMPILER_REQUIRES_SORT_RETURN
	return list;
#endif
}
```

## src/core_matrix.c
```c
/*
(C) 2014 EEMBC(R).  All rights reserved.                            

All EEMBC Benchmark Software are products of EEMBC 
and are provided under the terms of the EEMBC Benchmark License Agreements.  
The EEMBC Benchmark Software are proprietary intellectual properties of EEMBC and its Members 
and is protected under all applicable laws, including all applicable copyright laws.  
If you received this EEMBC Benchmark Software without having 
a currently effective EEMBC Benchmark License Agreement, you must discontinue use. 
Please refer to LICENSE.md for the specific license agreement that pertains to this Benchmark Software.
*/

/*
Author : Shay Gal-On, EEMBC
*/ 
#include "coremark.h"
/*
Topic: Description
	Matrix manipulation benchmark
	
	This very simple algorithm forms the basis of many more complex algorithms. 
	
	The tight inner loop is the focus of many optimizations (compiler as well as hardware based) 
	and is thus relevant for embedded processing. 
	
	The total available data space will be divided to 3 parts:
	NxN Matrix A - initialized with small values (upper 3/4 of the bits all zero).
	NxN Matrix B - initialized with medium values (upper half of the bits all zero).
	NxN Matrix C - used for the result.

	The actual values for A and B must be derived based on input that is not available at compile time.
*/
ee_s16 matrix_test(ee_u32 N, MATRES *C, MATDAT *A, MATDAT *B, MATDAT val);
ee_s16 matrix_sum(ee_u32 N, MATRES *C, MATDAT clipval);
void matrix_mul_const(ee_u32 N, MATRES *C, MATDAT *A, MATDAT val);
void matrix_mul_vect(ee_u32 N, MATRES *C, MATDAT *A, MATDAT *B);
void matrix_mul_matrix(ee_u32 N, MATRES *C, MATDAT *A, MATDAT *B);
void matrix_mul_matrix_bitextract(ee_u32 N, MATRES *C, MATDAT *A, MATDAT *B);
void matrix_add_const(ee_u32 N, MATDAT *A, MATDAT val);

#define matrix_test_next(x) (x+1)
#define matrix_clip(x,y) ((y) ? (x) & 0x0ff : (x) & 0x0ffff)
#define matrix_big(x) (0x1000 | (x))
#define bit_extract(x,from,numbits) (((x)>>(from)) & (~(0xffffffff << (numbits))))

#if CORE_DEBUG
void printmat(MATDAT *A, ee_u32 N, char *name) {
	ee_u32 i,j;
	ee_printf("Matrix %s [%dx%d]:\n",name,N,N);
	for (i=0; i<N; i++) {
		for (j=0; j<N; j++) {
			if (j!=0)
				ee_printf(",");
			ee_printf("%d",A[i*N+j]);
		}
		ee_printf("\n");
	}
}
void printmatC(MATRES *C, ee_u32 N, char *name) {
	ee_u32 i,j;
	ee_printf("Matrix %s [%dx%d]:\n",name,N,N);
	for (i=0; i<N; i++) {
		for (j=0; j<N; j++) {
			if (j!=0)
				ee_printf(",");
			ee_printf("%d",C[i*N+j]);
		}
		ee_printf("\n");
	}
}
#endif
/* Function: core_bench_matrix
	Benchmark function

	Iterate <matrix_test> N times, 
	changing the matrix values slightly by a constant amount each time.
*/
ee_u16 core_bench_matrix(mat_params *p, ee_s16 seed, ee_u16 crc) {
	ee_u32 N=p->N;
	MATRES *C=p->C;
	MATDAT *A=p->A;
	MATDAT *B=p->B;
	MATDAT val=(MATDAT)seed;

	crc=crc16_cm(matrix_test(N,C,A,B,val),crc);

	return crc;
}

/* Function: matrix_test
	Perform matrix manipulation.

	Parameters:
	N - Dimensions of the matrix.
	C - memory for result matrix.
	A - input matrix
	B - operator matrix (not changed during operations)

	Returns:
	A CRC value that captures all results calculated in the function.
	In particular, crc of the value calculated on the result matrix 
	after each step by <matrix_sum>.

	Operation:
	
	1 - Add a constant value to all elements of a matrix.
	2 - Multiply a matrix by a constant.
	3 - Multiply a matrix by a vector.
	4 - Multiply a matrix by a matrix.
	5 - Add a constant value to all elements of a matrix.

	After the last step, matrix A is back to original contents.
*/
ee_s16 matrix_test(ee_u32 N, MATRES *C, MATDAT *A, MATDAT *B, MATDAT val) {
	ee_u16 crc=0;
	MATDAT clipval=matrix_big(val);

	matrix_add_const(N,A,val); /* make sure data changes  */
#if CORE_DEBUG
	printmat(A,N,"matrix_add_const");
#endif
	matrix_mul_const(N,C,A,val);
	crc=crc16_cm(matrix_sum(N,C,clipval),crc);
#if CORE_DEBUG
	printmatC(C,N,"matrix_mul_const");
#endif
	matrix_mul_vect(N,C,A,B);
	crc=crc16_cm(matrix_sum(N,C,clipval),crc);
#if CORE_DEBUG
	printmatC(C,N,"matrix_mul_vect");
#endif
	matrix_mul_matrix(N,C,A,B);
	crc=crc16_cm(matrix_sum(N,C,clipval),crc);
#if CORE_DEBUG
	printmatC(C,N,"matrix_mul_matrix");
#endif
	matrix_mul_matrix_bitextract(N,C,A,B);
	crc=crc16_cm(matrix_sum(N,C,clipval),crc);
#if CORE_DEBUG
	printmatC(C,N,"matrix_mul_matrix_bitextract");
#endif
	
	matrix_add_const(N,A,-val); /* return matrix to initial value */
	return crc;
}

/* Function : matrix_init
	Initialize the memory block for matrix benchmarking.

	Parameters:
	blksize - Size of memory to be initialized.
	memblk - Pointer to memory block.
	seed - Actual values chosen depend on the seed parameter.
	p - pointers to <mat_params> containing initialized matrixes.

	Returns:
	Matrix dimensions.
	
	Note:
	The seed parameter MUST be supplied from a source that cannot be determined at compile time
*/
ee_u32 core_init_matrix(ee_u32 blksize, void *memblk, ee_s32 seed, mat_params *p, ee_u32 N) {
	MATDAT *A;
	MATDAT *B;
	ee_s32 order=1;
	MATDAT val;
	ee_u32 i=0,j=0;
	if (seed==0)
		seed=1;
	if (N==0) {
		while (j<blksize) {
			i++;
			j=i*i*2*4;		
		}
		N=i-1;
	}
	A=(MATDAT *)align_mem(memblk);
	B=A+N*N;

	for (i=0; i<N; i++) {
		for (j=0; j<N; j++) {
			seed = ( ( order * seed ) % 65536 );
			val = (seed + order);
			val=matrix_clip(val,0);
			B[i*N+j] = val;
			val =  (val + order);
			val=matrix_clip(val,1);
			A[i*N+j] = val;
			order++;
		}
	}

	p->A=A;
	p->B=B;
	p->C=(MATRES *)align_mem(B+N*N);
	p->N=N;
#if CORE_DEBUG
	printmat(A,N,"A");
	printmat(B,N,"B");
#endif
	return N;
}

/* Function: matrix_sum
	Calculate a function that depends on the values of elements in the matrix.

	For each element, accumulate into a temporary variable.
	
	As long as this value is under the parameter clipval, 
	add 1 to the result if the element is bigger then the previous.
	
	Otherwise, reset the accumulator and add 10 to the result.
*/
ee_s16 matrix_sum(ee_u32 N, MATRES *C, MATDAT clipval) {
	MATRES tmp=0,prev=0,cur=0;
	ee_s16 ret=0;
	ee_u32 i,j;
	for (i=0; i<N; i++) {
		for (j=0; j<N; j++) {
			cur=C[i*N+j];
			tmp+=cur;
			if (tmp>clipval) {
				ret+=10;
				tmp=0;
			} else {
				ret += (cur>prev) ? 1 : 0;
			}
			prev=cur;
		}
	}
	return ret;
}

/* Function: matrix_mul_const
	Multiply a matrix by a constant.
	This could be used as a scaler for instance.
*/
void matrix_mul_const(ee_u32 N, MATRES *C, MATDAT *A, MATDAT val) {
	ee_u32 i,j;
	for (i=0; i<N; i++) {
		for (j=0; j<N; j++) {
			C[i*N+j]=(MATRES)A[i*N+j] * (MATRES)val;
		}
	}
}

/* Function: matrix_add_const
	Add a constant value to all elements of a matrix.
*/
void matrix_add_const(ee_u32 N, MATDAT *A, MATDAT val) {
	ee_u32 i,j;
	for (i=0; i<N; i++) {
		for (j=0; j<N; j++) {
			A[i*N+j] += val;
		}
	}
}

/* Function: matrix_mul_vect
	Multiply a matrix by a vector.
	This is common in many simple filters (e.g. fir where a vector of coefficients is applied to the matrix.)
*/
void matrix_mul_vect(ee_u32 N, MATRES *C, MATDAT *A, MATDAT *B) {
	ee_u32 i,j;
	for (i=0; i<N; i++) {
		C[i]=0;
		for (j=0; j<N; j++) {
			C[i]+=(MATRES)A[i*N+j] * (MATRES)B[j];
		}
	}
}

/* Function: matrix_mul_matrix
	Multiply a matrix by a matrix.
	Basic code is used in many algorithms, mostly with minor changes such as scaling.
*/
void matrix_mul_matrix(ee_u32 N, MATRES *C, MATDAT *A, MATDAT *B) {
	ee_u32 i,j,k;
	for (i=0; i<N; i++) {
		for (j=0; j<N; j++) {
			C[i*N+j]=0;
			for(k=0;k<N;k++)
			{
				C[i*N+j]+=(MATRES)A[i*N+k] * (MATRES)B[k*N+j];
			}
		}
	}
}

/* Function: matrix_mul_matrix_bitextract
	Multiply a matrix by a matrix, and extract some bits from the result.
	Basic code is used in many algorithms, mostly with minor changes such as scaling.
*/
void matrix_mul_matrix_bitextract(ee_u32 N, MATRES *C, MATDAT *A, MATDAT *B) {
	ee_u32 i,j,k;
	for (i=0; i<N; i++) {
		for (j=0; j<N; j++) {
			C[i*N+j]=0;
			for(k=0;k<N;k++)
			{
				MATRES tmp=(MATRES)A[i*N+k] * (MATRES)B[k*N+j];
				C[i*N+j]+=bit_extract(tmp,2,4)*bit_extract(tmp,5,7);
			}
		}
	}
}
```

## src/core_mith.c
```c
/*
(C) 2014 EEMBC(R).  All rights reserved.                            

All EEMBC Benchmark Software are products of EEMBC 
and are provided under the terms of the EEMBC Benchmark License Agreements.  
The EEMBC Benchmark Software are proprietary intellectual properties of EEMBC and its Members 
and is protected under all applicable laws, including all applicable copyright laws.  
If you received this EEMBC Benchmark Software without having 
a currently effective EEMBC Benchmark License Agreement, you must discontinue use. 
Please refer to LICENSE.md for the specific license agreement that pertains to this Benchmark Software.
*/

/*************************
** MITH CoreMark version
** 
** Based on the version used for andebench.
** 
*************************/
#include "th_cfg.h"
#include "th_lib.h"
#include "th_rand.h" /* initialize a random data vector */
#include "coremark.h"
#include "core_mith.h"

core_params presets_core[] = {
	{0x3415,0x3415,0x66,31,2048,9,10000 ,0,NULL,0,
	{0x32cc,0xebc9,0x7e4d,0x535b}}
,
	{0x0,0x0,0x66,31,2048,9,1000 ,0,NULL,1,
	{0x33d,0xb5fb,0xb658,0x927b}}
,
	{0x33,0x33,0x33,10,512,4,100 ,0,NULL,2,
	{0x3d49,0x5b1,0x7eb,0xd135}}
,

};

/* ======================================================================== */
/*         Function Prototypes                            */
/* ======================================================================== */
/* file provides :
define - init base input params 
init -  allocate working memory
run - run the benchmark with defined params on working memory
fini - dealloc working memory
verify - Fully verify correct execution if needed
clean - deallocate output memory
*/
void *define_params_core(unsigned int idx, char *name, char *dataset);
void *bmark_init_core(void *);
void *t_run_test_core(struct TCDef *,void *);
int bmark_clean_core(void *);
int bmark_verify_core(void *in_params);
void *bmark_fini_core(void *in_params);


/* benchmark function declarations */
void *iterate(void *pres);

extern volatile e_s32 seed1_volatile;
extern volatile e_s32 seed2_volatile;
extern volatile e_s32 seed3_volatile;
extern volatile e_s32 seed4_volatile;
extern volatile e_s32 seed5_volatile;
volatile e_u32 list_items=0;
volatile e_u32 state_size=0;
volatile e_u32 matrix_n=0;
volatile e_u32 total_data_size=0;
volatile e_u32 mem_req[32];
volatile ee_u32 time_multiplier;

void *define_params_core(unsigned int idx, char *name, char *dataset) {
    core_params *params;
	e_s32 data_index=idx;

	/* parameter setup */
	params=(core_params *)th_malloc(sizeof(core_params));
	if ( params == NULL )
          th_exit( THE_OUT_OF_MEMORY, "Cannot Allocate Memory %s:%d", __FILE__,__LINE__ );

	th_memset(params,0,sizeof(core_params));
	th_memcpy(params,&(presets_core[0]),sizeof(core_params));
	
	if (pgo_training_run!=0) {
		data_index=2; 
	} else {
		th_parse_buf_flag(dataset,"-I",&data_index);
	}
	/* preset datasets */
	if ((data_index>=0) && (data_index<sizeof(presets_core)/sizeof(core_params))) {
		th_memcpy(params,&(presets_core[data_index]),sizeof(core_params));
	} 
	params->data_id=data_index;
	params->results=(core_results *)th_malloc(sizeof(core_results));
	/* command line overrides */
	if (pgo_training_run==0) {
		th_parse_buf_flag(dataset,"-g",&params->gen_ref);
		th_parse_buf_flag_unsigned(dataset,"-L",&params->li);
		th_parse_buf_flag_unsigned(dataset,"-S",&params->ss);
		th_parse_buf_flag_unsigned(dataset,"-M",&params->mn);
		th_parse_buf_flag_unsigned(dataset,"-a",&params->s1);
		th_parse_buf_flag_unsigned(dataset,"-b",&params->s2);
		th_parse_buf_flag_unsigned(dataset,"-c",&params->s3);
		th_parse_buf_flag_unsigned(dataset,"-i",&params->iterations);
	}
	/* setup data for memory alloc and init */
	params->results->iterations=params->iterations;
	params->results->seed1=params->s1;
	params->results->seed2=params->s2;
	params->results->seed3=params->s3;
	state_size=params->ss;
	list_items=params->li;
	matrix_n=params->mn;
	
	mem_req[ID_STATE]=state_size+PADDING/3;
	mem_req[ID_LIST]=((16+sizeof(struct list_data_s))*(list_items+2))+PADDING/3;
	mem_req[ID_MATRIX]=((matrix_n)*(matrix_n)*(2*sizeof(MATDAT) + sizeof(MATRES)))+PADDING/3;
	total_data_size=mem_req[ID_STATE] + mem_req[ID_LIST] + mem_req[ID_MATRIX];
	params->results->size=state_size;
	params->results->err=0;
	params->size=total_data_size;
	
	check_data_types();

	return params;
}


int bmark_clean_core(void *in_params) {
	core_params *params=(core_params *)in_params;
	if (in_params==NULL)
		th_exit( THE_BAD_PTR, "Invalid pointer %s:%d", __FILE__,__LINE__ );
	th_free(params->results);
	th_free(params);
	return 1;
}

void *bmark_init_core(void *in_params) {
	core_params *params=(core_params *)in_params;
    core_params *p;
	if (in_params==NULL)
		th_exit( THE_BAD_PTR, "Invalid pointer %s:%d", __FILE__,__LINE__ );
	p=(core_params *)th_malloc(sizeof(core_params));
	if ( p == NULL )
          th_exit( THE_OUT_OF_MEMORY, "Cannot Allocate Memory %s:%d", __FILE__,__LINE__ );
	th_memcpy(p,params,sizeof(core_params));
	/* alloc memory */
	p->results=(core_results *)th_malloc(sizeof(core_results));
	th_memcpy(p->results,params->results,sizeof(core_results));
	p->results->memblock[0]=th_malloc(params->size);
	if ( p->results->memblock[0] == NULL )
          th_exit( THE_OUT_OF_MEMORY, "Cannot Allocate Memory %s:%d", __FILE__,__LINE__ );
	/* assign memory */
	{
		ee_u32 reserved=0;
		int i;
		for (i=0; i<3; i++) {
			ee_u32 id=(1<<(ee_u32)i);
			p->results->memblock[i+1]=(char *)(p->results->memblock[0])+reserved;
			reserved+=mem_req[id];
		}
	}
	/* init data structures */
	{
		ee_u32 per_item=16+sizeof(struct list_data_s); /* to accomodate systems with 64b pointers, and make sure same code is executed, set max list elements */
		p->results->list=core_list_init(p->li,p->results->memblock[1],p->results->seed1);
		core_init_matrix(mem_req[ID_MATRIX], p->results->memblock[2], (ee_s32)p->results->seed1 | (((ee_s32)p->results->seed2) << 16), &(p->results->mat), p->mn );
		core_init_state(p->ss,p->results->seed1,p->results->memblock[3]);
	}
	
	return p;
}
void *bmark_fini_core(void *in_params) {
    core_params *params;
	if (in_params==NULL)
		th_exit( THE_BAD_PTR, "Invalid pointer %s:%d", __FILE__,__LINE__ );
	params=(core_params *)in_params;

	if ( params->results->memblock[0] != NULL )
		th_free(params->results->memblock[0]);
	th_free(params->results);
	th_free(params);

	return NULL;
}

void *t_run_test_core(struct TCDef *tcdef,void *in_params) {
	core_params *p=(core_params *)in_params;
	e_u32 test1=0, test2=0;
	int i,j;
	
	tcdef->expected_CRC=0;
	iterate(p->results);
		
	if (p->gen_ref)
		tcdef->CRC=0;
		
	return tcdef;
}

int bmark_verify_core(void *in_params) {
	int i;
	core_params *p=(core_params *)in_params;
	int err=0;

	e_u32 s1,s2,s3;
	e_u32 li,ss,mn;
	e_u32 seed;
	e_s32 gen_ref;
	core_results *results;
	int data_id;
	e_u16 crc[4];
	e_u16 seedcrc=crc16_cm(p->results->seed1,0);
	seedcrc=crc16_cm(p->results->seed2,seedcrc);
	seedcrc=crc16_cm(p->results->seed3,seedcrc);
	seedcrc=crc16_cm(p->size,seedcrc);

	if (p->gen_ref) {
		ee_printf("{0x%x,0x%x,0x%x,",		  p->s1,p->s2,p->s3);
		ee_printf("%d,%d,%d,%d ,0,NULL,%d,\n", p->li,p->ss,p->mn,p->iterations, 	p->data_id);
		ee_printf("{0x%x,0x%x,0x%x,0x%x}}\n",p->results->crclist,p->results->crcmatrix,p->results->crcstate,p->results->crc);
	} else {
		i=p->data_id;
		if ((p->results->crclist!=p->crc[0])) {
			ee_printf("[%u]ERROR! list crc 0x%04x - should be 0x%04x\n",i,p->results->crclist,p->crc[0]);
			p->results->err++;
		}
		if ((p->results->crcmatrix!=p->crc[1])) {
			ee_printf("[%u]ERROR! matrix crc 0x%04x - should be 0x%04x\n",i,p->results->crcmatrix,p->crc[1]);
			p->results->err++;
		}
		if ((p->results->crcstate!=p->crc[2])) {
			ee_printf("[%u]ERROR! state crc 0x%04x - should be 0x%04x\n",i,p->results->crcstate,p->crc[2]);
			p->results->err++;
		}
		if ((p->results->crc!=p->crc[3])) {
			ee_printf("[%u]ERROR! final crc 0x%04x - should be 0x%04x\n",i,p->results->crc,p->crc[3]);
			p->results->err++;
		}
	}
	if (p->results->err>0) {
		ee_printf(" - Sizes: %d/%d/%d:%d\n",p->li,p->mn,p->ss,p->results->size);
		ee_printf(" - Seeds: 0x%x/0x%x/0x%x\n",p->s1,p->s2,p->s3);
		return -1;
	}
	return 1;
}
void *iterate(void *pres) {
	ee_u32 i;
	ee_u16 crc;
	core_results *res=(core_results *)pres;
	ee_u32 iterations=res->iterations;
	res->crc=0;
	res->crclist=0;
	res->crcmatrix=0;
	res->crcstate=0;

	for (i=0; i<iterations; i++) {
		crc=core_bench_list(res,1);
		res->crc=crcu16(crc,res->crc);
		crc=core_bench_list(res,-1);
		res->crc=crcu16(crc,res->crc);
		if (i==0) res->crclist=res->crc;
	}
	return NULL;
}
```

## src/core_util.c
```c
/*
(C) 2014 EEMBC(R).  All rights reserved.                            

All EEMBC Benchmark Software are products of EEMBC 
and are provided under the terms of the EEMBC Benchmark License Agreements.  
The EEMBC Benchmark Software are proprietary intellectual properties of EEMBC and its Members 
and is protected under all applicable laws, including all applicable copyright laws.  
If you received this EEMBC Benchmark Software without having 
a currently effective EEMBC Benchmark License Agreement, you must discontinue use. 
Please refer to LICENSE.md for the specific license agreement that pertains to this Benchmark Software.
*/
/*
Author : Shay Gal-On, EEMBC

*/ 
#include "coremark.h"
#if USE_CRC_TABLE
#define crcu8_bytable crcu8
#else
#define crcu8_byloop crcu8
#endif
/* Function: get_seed
	Get a values that cannot be determined at compile time.

	Since different embedded systems and compilers are used, 3 different methods are provided:
	1 - Using a volatile variable. This method is only valid if the compiler is forced to generate code that
	reads the value of a volatile variable from memory at run time. 
	Please note, if using this method, you would need to modify core_portme.c to generate training profile.
	2 - Command line arguments. This is the preferred method if command line arguments are supported.
	3 - System function. If none of the first 2 methods is available on the platform,
	a system function which is not a stub can be used.
	
	e.g. read the value on GPIO pins connected to switches, or invoke special simulator functions.
*/
extern volatile ee_s32 seed1_volatile;
extern volatile ee_s32 seed2_volatile;
extern volatile ee_s32 seed3_volatile;
extern volatile ee_s32 seed4_volatile;
extern volatile ee_s32 seed5_volatile;
ee_s32 get_seed_32(int i) {
	ee_s32 retval;
	switch (i) {
		case 1:
			retval=seed1_volatile;
			break;
		case 2:
			retval=seed2_volatile;
			break;
		case 3:
			retval=seed3_volatile;
			break;
		case 4:
			retval=seed4_volatile;
			break;
		case 5:
			retval=seed5_volatile;
			break;
		case 6:
			retval=0;
			break;
		case 7:
			retval=total_data_size;
			break;
		default:
			retval=0;
			break;
	}
	return retval;
}

static  ee_u16 crcu8_table[256] = {
        0x0,0xc0c1,0xc181,0x140,
        0xc301,0x3c0,0x280,0xc241,
        0xc601,0x6c0,0x780,0xc741,
        0x500,0xc5c1,0xc481,0x440,
        0xcc01,0xcc0,0xd80,0xcd41,
        0xf00,0xcfc1,0xce81,0xe40,
        0xa00,0xcac1,0xcb81,0xb40,
        0xc901,0x9c0,0x880,0xc841,
        0xd801,0x18c0,0x1980,0xd941,
        0x1b00,0xdbc1,0xda81,0x1a40,
        0x1e00,0xdec1,0xdf81,0x1f40,
        0xdd01,0x1dc0,0x1c80,0xdc41,
        0x1400,0xd4c1,0xd581,0x1540,
        0xd701,0x17c0,0x1680,0xd641,
        0xd201,0x12c0,0x1380,0xd341,
        0x1100,0xd1c1,0xd081,0x1040,
        0xf001,0x30c0,0x3180,0xf141,
        0x3300,0xf3c1,0xf281,0x3240,
        0x3600,0xf6c1,0xf781,0x3740,
        0xf501,0x35c0,0x3480,0xf441,
        0x3c00,0xfcc1,0xfd81,0x3d40,
        0xff01,0x3fc0,0x3e80,0xfe41,
        0xfa01,0x3ac0,0x3b80,0xfb41,
        0x3900,0xf9c1,0xf881,0x3840,
        0x2800,0xe8c1,0xe981,0x2940,
        0xeb01,0x2bc0,0x2a80,0xea41,
        0xee01,0x2ec0,0x2f80,0xef41,
        0x2d00,0xedc1,0xec81,0x2c40,
        0xe401,0x24c0,0x2580,0xe541,
        0x2700,0xe7c1,0xe681,0x2640,
        0x2200,0xe2c1,0xe381,0x2340,
        0xe101,0x21c0,0x2080,0xe041,
        0xa001,0x60c0,0x6180,0xa141,
        0x6300,0xa3c1,0xa281,0x6240,
        0x6600,0xa6c1,0xa781,0x6740,
        0xa501,0x65c0,0x6480,0xa441,
        0x6c00,0xacc1,0xad81,0x6d40,
        0xaf01,0x6fc0,0x6e80,0xae41,
        0xaa01,0x6ac0,0x6b80,0xab41,
        0x6900,0xa9c1,0xa881,0x6840,
        0x7800,0xb8c1,0xb981,0x7940,
        0xbb01,0x7bc0,0x7a80,0xba41,
        0xbe01,0x7ec0,0x7f80,0xbf41,
        0x7d00,0xbdc1,0xbc81,0x7c40,
        0xb401,0x74c0,0x7580,0xb541,
        0x7700,0xb7c1,0xb681,0x7640,
        0x7200,0xb2c1,0xb381,0x7340,
        0xb101,0x71c0,0x7080,0xb041,
        0x5000,0x90c1,0x9181,0x5140,
        0x9301,0x53c0,0x5280,0x9241,
        0x9601,0x56c0,0x5780,0x9741,
        0x5500,0x95c1,0x9481,0x5440,
        0x9c01,0x5cc0,0x5d80,0x9d41,
        0x5f00,0x9fc1,0x9e81,0x5e40,
        0x5a00,0x9ac1,0x9b81,0x5b40,
        0x9901,0x59c0,0x5880,0x9841,
        0x8801,0x48c0,0x4980,0x8941,
        0x4b00,0x8bc1,0x8a81,0x4a40,
        0x4e00,0x8ec1,0x8f81,0x4f40,
        0x8d01,0x4dc0,0x4c80,0x8c41,
        0x4400,0x84c1,0x8581,0x4540,
        0x8701,0x47c0,0x4680,0x8641,
        0x8201,0x42c0,0x4380,0x8341,
        0x4100,0x81c1,0x8081,0x4040
};


ee_u16 crcu8_bytable(ee_u8 data, ee_u16 crc )
{
        return (crc >> 8) ^ crcu8_table[(crc ^ data) & 0x00ff];
}
/* Function: crc*
	Service functions to calculate 16b CRC code.

*/
ee_u16 crcu8_byloop(ee_u8 data, ee_u16 crc )
{
	ee_u8 i=0,x16=0,carry=0;

	for (i = 0; i < 8; i++)
    {
		x16 = (ee_u8)((data & 1) ^ ((ee_u8)crc & 1));
		data >>= 1;

		if (x16 == 1)
		{
		   crc ^= 0x4002;
		   carry = 1;
		}
		else 
			carry = 0;
		crc >>= 1;
		if (carry)
		   crc |= 0x8000;
		else
		   crc &= 0x7fff;
    }
	return crc;
} 
ee_u16 crcu16(ee_u16 newval, ee_u16 crc) {
	crc=crcu8( (ee_u8) (newval)				,crc);
	crc=crcu8( (ee_u8) ((newval)>>8)	,crc);
	return crc;
}
ee_u16 crcu32(ee_u32 newval, ee_u16 crc) {
	crc=crc16_cm((ee_s16) newval		,crc);
	crc=crc16_cm((ee_s16) (newval>>16)	,crc);
	return crc;
}
ee_u16 crc16_cm(ee_s16 newval, ee_u16 crc) {
	return crcu16((ee_u16)newval, crc);
}

ee_u8 check_data_types() {
	ee_u8 retval=0;
	if (sizeof(ee_u8) != 1) {
		ee_printf("ERROR: ee_u8 is not an 8b datatype!\n");
		retval++;
	}
	if (sizeof(ee_u16) != 2) {
		ee_printf("ERROR: ee_u16 is not a 16b datatype!\n");
		retval++;
	}
	if (sizeof(ee_s16) != 2) {
		ee_printf("ERROR: ee_s16 is not a 16b datatype!\n");
		retval++;
	}
	if (sizeof(ee_s32) != 4) {
		ee_printf("ERROR: ee_s32 is not a 32b datatype!\n");
		retval++;
	}
	if (sizeof(ee_u32) != 4) {
		ee_printf("ERROR: ee_u32 is not a 32b datatype!\n");
		retval++;
	}
	if (sizeof(ee_ptr_int) != sizeof(int *)) {
		ee_printf("ERROR: ee_ptr_int is not a datatype that holds an int pointer!\n");
		retval++;
	}
	if (retval>0) {
		ee_printf("ERROR: Please modify the datatypes in core_portme.h!\n");
	}
	return retval;
}
```

## src/coremark.h
```c
/*
(C) 2014 EEMBC(R).  All rights reserved.                            

All EEMBC Benchmark Software are products of EEMBC 
and are provided under the terms of the EEMBC Benchmark License Agreements.  
The EEMBC Benchmark Software are proprietary intellectual properties of EEMBC and its Members 
and is protected under all applicable laws, including all applicable copyright laws.  
If you received this EEMBC Benchmark Software without having 
a currently effective EEMBC Benchmark License Agreement, you must discontinue use. 
Please refer to LICENSE.md for the specific license agreement that pertains to this Benchmark Software.
*/
/*
Author : Shay Gal-On, EEMBC
*/ 
/* Topic: Description
	This file contains  declarations of the various benchmark functions.
*/

/* Configuration: TOTAL_DATA_SIZE
	Define total size for data algorithms will operate on
*/
#ifndef _COREMARK_H_
#define _COREMARK_H_

#ifndef TOTAL_DATA_SIZE 
#define TOTAL_DATA_SIZE 2*1000
#endif

#define SEED_ARG 0
#define SEED_FUNC 1
#define SEED_VOLATILE 2

#define MEM_STATIC 0
#define MEM_MALLOC 1
#define MEM_STACK 2

#include "core_portme.h"

#if HAS_STDIO
#include <stdio.h>
#endif
#if HAS_PRINTF
#define ee_printf printf
#endif

/* Actual benchmark execution in iterate */
void *iterate(void *pres);

/* Typedef: secs_ret
	For machines that have floating point support, get number of seconds as a double. 
	Otherwise an unsigned int.
*/
#if HAS_FLOAT
typedef double secs_ret;
#else
typedef ee_u32 secs_ret;
#endif

#if MAIN_HAS_NORETURN
#define MAIN_RETURN_VAL 
#define MAIN_RETURN_TYPE void
#else
#define MAIN_RETURN_VAL 0
#define MAIN_RETURN_TYPE int
#endif 

/* Misc useful functions */
ee_u16 crcu8(ee_u8 data, ee_u16 crc);
ee_u16 crc16_cm(ee_s16 newval, ee_u16 crc);
ee_u16 crcu16(ee_u16 newval, ee_u16 crc);
ee_u16 crcu32(ee_u32 newval, ee_u16 crc);
ee_u8 check_data_types();
void *portable_malloc(ee_size_t size);
void portable_free(void *p);
ee_s32 parseval(char *valstring);

/* Algorithm IDS */
#define ID_LIST 	(1<<0)
#define ID_MATRIX 	(1<<1)
#define ID_STATE 	(1<<2)
#define ALL_ALGORITHMS_MASK (ID_LIST|ID_MATRIX|ID_STATE)
#define NUM_ALGORITHMS 3

/* list data structures */
typedef struct list_data_s {
	ee_s16 data16;
	ee_s16 idx;
} list_data;

typedef struct list_head_s {
	struct list_head_s *next;
	struct list_data_s *info;
} list_head;


/*matrix benchmark related stuff */
#define MATDAT_INT 1
#if MATDAT_INT
typedef ee_s16 MATDAT;
typedef ee_s32 MATRES;
#else
typedef ee_f16 MATDAT;
typedef ee_f32 MATRES;
#endif

typedef struct MAT_PARAMS_S {
	int N;
	MATDAT *A;
	MATDAT *B;
	MATRES *C;
} mat_params;

/* state machine related stuff */
/* List of all the possible states for the FSM */
typedef enum CORE_STATE {
	CORE_START=0,
	CORE_INVALID,
	CORE_S1,
	CORE_S2,
	CORE_INT,
	CORE_FLOAT,
	CORE_EXPONENT,
	CORE_SCIENTIFIC,
	NUM_CORE_STATES
} core_state_e ;

		
/* Helper structure to hold results */
typedef struct RESULTS_S {
	/* inputs */
	ee_s16	seed1;		/* Initializing seed */
	ee_s16	seed2;		/* Initializing seed */
	ee_s16	seed3;		/* Initializing seed */
	void	*memblock[4];	/* Pointer to safe memory location */
	ee_u32	size;		/* Size of the data */
	ee_u32 iterations;		/* Number of iterations to execute */
	ee_u32	execs;		/* Bitmask of operations to execute */
	struct list_head_s *list;
	mat_params mat;
	/* outputs */
	ee_u16	crc;
	ee_u16	crclist;
	ee_u16	crcmatrix;
	ee_u16	crcstate;
	ee_s16	err;
	/* ultithread specific */
	core_portable port;
} core_results;


/* Multicore execution handling */
#if (MULTITHREAD>1)
ee_u8 core_start_parallel(core_results *res);
ee_u8 core_stop_parallel(core_results *res);
#endif

/* list benchmark functions */
list_head *core_list_init(ee_u32 blksize, list_head *memblock, ee_s16 seed);
ee_u16 core_bench_list(core_results *res, ee_s16 finder_idx);

/* state benchmark functions */
void core_init_state(ee_u32 size, ee_s16 seed, ee_u8 *p);
ee_u16 core_bench_state(ee_u32 blksize, ee_u8 *memblock, 
		ee_s16 seed1, ee_s16 seed2, ee_s16 step, ee_u16 crc);

/* matrix benchmark functions */
ee_u32 core_init_matrix(ee_u32 blksize, void *memblk, ee_s32 seed, mat_params *p, ee_u32 N);
ee_u16 core_bench_matrix(mat_params *p, ee_s16 seed, ee_u16 crc);

extern volatile ee_u32 list_items;
extern volatile ee_u32 state_size;
extern volatile ee_u32 matrix_n;
extern volatile ee_u32 total_data_size;
extern volatile ee_u32 mem_req[32];

#endif /* _COREMARK_H_ */
```
